#include "dactyl.dtsi"

// Left half. Row GPIOs match the assimilator-bt "imprint" wiring; the left
// half uses the transform as-is (no row offset). In the normal split this
// half is the central; in dongle mode it is built as a peripheral
// (CONFIG_ZMK_SPLIT_ROLE_CENTRAL=n) — see build.yaml.
&kscan0 {
    row-gpios
        = <&gpio1 4 GPIO_ACTIVE_HIGH> // row0 from schematic
        , <&gpio0 11 GPIO_ACTIVE_HIGH> // row1 from schematic
        , <&gpio0 29 GPIO_ACTIVE_HIGH> // row2 from schematic
        , <&gpio1 0 GPIO_ACTIVE_HIGH> // row3 from schematic
        , <&gpio0 10 GPIO_ACTIVE_HIGH> // row4 from schematic
        , <&gpio0 2 GPIO_ACTIVE_HIGH> // row5 from schematic
        , <&gpio0 9 GPIO_ACTIVE_HIGH> // row6 from schematic
        ;
};
