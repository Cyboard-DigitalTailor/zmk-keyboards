## boards/shields/imprint_wired/Kconfig.shield
```kconfig
config SHIELD_IMPRINT_WIRED_LEFT
    def_bool $(shields_list_contains,imprint_wired_left)

config SHIELD_IMPRINT_WIRED_RIGHT
    def_bool $(shields_list_contains,imprint_wired_right)
```
