## Kconfig
```kconfig
# Copyright (c) 2026 The ZMK Contributors
# SPDX-License-Identifier: MIT

DT_COMPAT_ZMK_STUDIO_UNLOCK_COMBO := zmk,studio-unlock-combo

config ZMK_STUDIO_UNLOCK_COMBO
    bool "Keymap-independent unlock key combo"
    depends on ZMK_STUDIO_LOCKING
    default $(dt_compat_enabled,$(DT_COMPAT_ZMK_STUDIO_UNLOCK_COMBO))
    help
      Unlock ZMK Studio by holding a fixed set of physical keys (defined
      in devicetree by matrix row/column) for a configured duration,
      without requiring a &studio_unlock binding in the keymap.
```

## boards/arm/assimilator-bt/Kconfig.board
```kconfig
# SPDX-License-Identifier: MIT

config BOARD_ASSIMILATOR_BT
    bool "assimilator-bt"
    depends on SOC_NRF52840_QIAA
```

## boards/arm/assimilator-bt/Kconfig.defconfig
```kconfig
# SPDX-License-Identifier: MIT

if BOARD_ASSIMILATOR_BT

config BOARD
    default "assimilator-bt"

if USB_DEVICE_STACK

config USB_NRFX
    default y

endif # USB_DEVICE_STACK

config BT_CTLR
    default BT

endif # BOARD_ASSIMILATOR_BT
```

## boards/arm/cyboard/Kconfig
```kconfig
# SPDX-License-Identifier: MIT

config BOARD_ENABLE_DCDC_HV
    bool "High voltage DCDC converter"
    select SOC_DCDC_NRF52X_HV
    default y
    depends on (BOARD_CYBOARD)
```

## boards/arm/cyboard/Kconfig.board
```kconfig
# SPDX-License-Identifier: MIT

config BOARD_CYBOARD
    bool "cyboard"
    depends on SOC_NRF52840_QIAA
```

## boards/arm/cyboard/Kconfig.defconfig
```kconfig
# SPDX-License-Identifier: MIT

if BOARD_CYBOARD

config BOARD
    default "cyboard"

if USB_DEVICE_STACK

config USB_NRFX
    default y

endif # USB_DEVICE_STACK

config BT_CTLR
    default BT

endif # BOARD_CYBOARD
```

## boards/arm/speller/Kconfig.board
```kconfig
# SPDX-License-Identifier: MIT

config BOARD_SPELLER
    bool "speller"
    depends on SOC_NRF52840_QIAA
```

## boards/arm/speller/Kconfig.defconfig
```kconfig
# SPDX-License-Identifier: MIT

if BOARD_SPELLER

config BOARD
    default "speller"

if USB_DEVICE_STACK

config USB_NRFX
    default y

endif # USB_DEVICE_STACK

config BT_CTLR
    default BT

config ZMK_KEYBOARD_NAME
    default "Speller"

config ZMK_RGB_UNDERGLOW
    default y
    imply WS2812_STRIP
    imply CONFIG_ZMK_RGB_UNDERGLOW_BRT_MAX=50

endif # BOARD_SPELLER
```

## boards/arm/speller/speller_defconfig
```kconfig
# SPDX-License-Identifier: MIT

CONFIG_SOC_SERIES_NRF52X=y
CONFIG_SOC_NRF52840_QIAA=y
CONFIG_BOARD_SPELLER=y

# Enable MPU
CONFIG_ARM_MPU=y
# Enable 32kHz crystal
CONFIG_CLOCK_CONTROL_NRF_K32SRC_XTAL=y
CONFIG_CLOCK_CONTROL_NRF_K32SRC_150PPM=y

# Use pinctrl
CONFIG_PINCTRL=y

# enable GPIO
CONFIG_GPIO=y

CONFIG_USE_DT_CODE_PARTITION=y
CONFIG_BUILD_OUTPUT_UF2=y

CONFIG_MPU_ALLOW_FLASH_WRITE=y
CONFIG_NVS=y
CONFIG_SETTINGS_NVS=y
CONFIG_FLASH=y
CONFIG_FLASH_PAGE_LAYOUT=y
CONFIG_FLASH_MAP=y

CONFIG_ZMK_BLE=y
CONFIG_ZMK_USB=y

CONFIG_ZMK_MAX17048=y
CONFIG_I2C=y
CONFIG_ZMK_BATTERY_REPORT_INTERVAL=60

CONFIG_ZMK_RGB_UNDERGLOW_BRT_MAX=50
```

## boards/cyboard/assimilator-bt/Kconfig.assimilator-bt
```kconfig
# SPDX-License-Identifier: MIT

config BOARD_ASSIMILATOR_BT
    select SOC_NRF52840_QIAA
    imply RETAINED_MEM
    imply RETENTION
    imply RETENTION_BOOT_MODE
```

## boards/cyboard/assimilator-bt/Kconfig.defconfig
```kconfig
# SPDX-License-Identifier: MIT

if BOARD_ASSIMILATOR_BT

config BOARD
    default "assimilator-bt"

if USB_DEVICE_STACK

config USB_NRFX
    default y

endif # USB_DEVICE_STACK

config BT_CTLR
    default BT

choice ZMK_BOOTMODE_MAGIC_VALUE_BOOTLOADER_TYPE
    default ZMK_BOOTMODE_MAGIC_VALUE_BOOTLOADER_TYPE_ADAFRUIT_NRF52
endchoice

endif # BOARD_ASSIMILATOR_BT
```

## boards/shields/cyboard/Kconfig.defconfig
```kconfig
if SHIELD_CYBOARD_LEFT

config ZMK_KEYBOARD_NAME
    default "Cyboard"

config ZMK_SPLIT_ROLE_CENTRAL
    default y

endif

if SHIELD_CYBOARD_LEFT || SHIELD_CYBOARD_RIGHT

config ZMK_SPLIT
    default n

endif

config ZMK_RGB_UNDERGLOW
    default y
    imply WS2812_STRIP
```

## boards/shields/cyboard/Kconfig.shield
```kconfig
config SHIELD_CYBOARD_LEFT
    def_bool $(shields_list_contains,cyboard_left)

config SHIELD_CYBOARD_RIGHT
    def_bool $(shields_list_contains,cyboard_right)
```

## boards/shields/cyboard_dactyl_single_arc_number_row/Kconfig.defconfig
```kconfig
if SHIELD_CYBOARD_DACTYL_SINGLE_ARC_NUMBER_ROW_LEFT

config ZMK_KEYBOARD_NAME
    default "Cyboard Dactyl"

config ZMK_SPLIT_ROLE_CENTRAL
    default y

endif

if SHIELD_CYBOARD_DACTYL_SINGLE_ARC_NUMBER_ROW_LEFT || SHIELD_CYBOARD_DACTYL_SINGLE_ARC_NUMBER_ROW_RIGHT

config ZMK_SPLIT
    default y

endif
```

## boards/shields/cyboard_dactyl_single_arc_number_row/Kconfig.shield
```kconfig
config SHIELD_CYBOARD_DACTYL_SINGLE_ARC_NUMBER_ROW_LEFT
    def_bool $(shields_list_contains,cyboard_dactyl_single_arc_number_row_left)

config SHIELD_CYBOARD_DACTYL_SINGLE_ARC_NUMBER_ROW_RIGHT
    def_bool $(shields_list_contains,cyboard_dactyl_single_arc_number_row_right)
```

## boards/shields/dactyl/Kconfig.defconfig
```kconfig
if SHIELD_DACTYL_LEFT

config ZMK_KEYBOARD_NAME
    default "Dactyl"

# Left is the split central in the normal (no-dongle) configuration. In
# dongle mode this is overridden to n at build time so both halves become
# BLE peripherals of the dongle (see build.yaml / the dongle shield).
config ZMK_SPLIT_ROLE_CENTRAL
    default y

endif

if SHIELD_DACTYL_LEFT || SHIELD_DACTYL_RIGHT

config ZMK_SPLIT
    default y

config ZMK_SLEEP
    default y

endif

# NOTE: RGB underglow defaults (ZMK_RGB_UNDERGLOW=y, brightness, etc.) are
# declared module-wide, outside a shield guard, in the imprint shield's
# Kconfig.defconfig, so every build in this repo inherits them. That is why
# each dactyl board overlay must still define a zmk,underglow strip even
# though this shield sets no RGB config of its own — rgb_underglow.c will not
# compile without a chosen strip. This dactyl has no trackball, so none of
# the imprint pointing/PMW3610/SPI config is carried here.
```

## boards/shields/dactyl/Kconfig.shield
```kconfig
config SHIELD_DACTYL_LEFT
    def_bool $(shields_list_contains,dactyl_left)

config SHIELD_DACTYL_RIGHT
    def_bool $(shields_list_contains,dactyl_right)
```

## boards/shields/dactyl_dongle/Kconfig.defconfig
```kconfig
if SHIELD_DACTYL_DONGLE

config ZMK_KEYBOARD_NAME
    default "Dactyl Dongle"

config ZMK_USB
    default y

config ZMK_BLE
    default y

config ZMK_SPLIT
    default y

config ZMK_SPLIT_ROLE_CENTRAL
    default y

# Both dactyl halves connect to the dongle as BLE peripherals.
config ZMK_SPLIT_BLE_CENTRAL_PERIPHERALS
    default 2

# The dongle is USB-powered and has no keys of its own, so it never sleeps.
config ZMK_SLEEP
    default n

endif

# This dactyl has no trackball, so there is no ZMK_POINTING / PMW3610 / SPI
# pointing config here (unlike the imprint dongle). RGB underglow stays on
# module-wide (see the imprint shield's Kconfig.defconfig) and the board
# overlay supplies the required zmk,underglow strip; the dongle, as split
# central, is what dispatches &rgb_ug to the halves.
```

## boards/shields/imprint/Kconfig.shield
```kconfig
config SHIELD_IMPRINT_LEFT
    def_bool $(shields_list_contains,imprint_left)

config SHIELD_IMPRINT_RIGHT
    def_bool $(shields_list_contains,imprint_right)
```

## boards/shields/imprint_dongle/Kconfig.defconfig
```kconfig
if SHIELD_IMPRINT_DONGLE

config ZMK_KEYBOARD_NAME
    default "Imprint Dongle"

config ZMK_USB
    default y

config ZMK_BLE
    default y

config ZMK_SPLIT
    default y

config ZMK_SPLIT_ROLE_CENTRAL
    default y

config ZMK_SPLIT_BLE_CENTRAL_PERIPHERALS
    default 2

# The dongle terminates the pointing pipeline (it produces the mouse HID
# reports); without this the input-split proxies and listeners compile out
# and both trackballs go dead unless the user config sets it.
config ZMK_POINTING
    default y

config ZMK_SLEEP
    default n

config PMW3610
    default n

endif
```

## boards/shields/imprint_dongle/Kconfig.shield
```kconfig
config SHIELD_IMPRINT_DONGLE
    def_bool $(shields_list_contains,imprint_dongle)
```

## boards/shields/imprint_dongle/boards/seeeduino_xiao_ble.conf
```kconfig
# ZMK defaults ZMK_RGB_UNDERGLOW_EXT_POWER=y whenever RGB is enabled, and
# rgb_underglow.c then requires a zmk,ext-power-generic node — which this
# board doesn't have (our assimilator-bt does). RGB itself stays enabled
# (see seeeduino_xiao_ble.overlay); only the ext-power coupling is off.
CONFIG_ZMK_RGB_UNDERGLOW_EXT_POWER=n
```

## dts/bindings/zmk,studio-unlock-combo.yaml
```yaml
# Copyright (c) 2026 The ZMK Contributors
# SPDX-License-Identifier: MIT

description: |
  Keymap-independent ZMK Studio unlock combo.

  Holding all of the listed keys for hold-time-ms unlocks the device for
  ZMK Studio, exactly like the &studio_unlock behavior, but without needing
  any binding in the user's keymap (which the user could edit away and lock
  themselves out).

  Keys are identified by kscan matrix row/column (use the RC() macro from
  dt-bindings/zmk/matrix_transform.h), not by key position, so the combo
  stays valid across physical layouts with differing key counts.

compatible: "zmk,studio-unlock-combo"

properties:
  keys:
    type: array
    required: true
    description: |
      RC()-encoded matrix coordinates of the keys that must all be held.
      Coordinates that the active layout's matrix transform does not map
      are ignored.

  hold-time-ms:
    type: int
    default: 3000
    description: |
      How long all keys must be held simultaneously before the device
      unlocks, in milliseconds.
```
